## Config.in
```kconfig
source "$BR2_EXTERNAL_APRSPI_PATH/package/hamlib/Config.in"
source "$BR2_EXTERNAL_APRSPI_PATH/package/gen_fff/Config.in.host"
source "$BR2_EXTERNAL_APRSPI_PATH/package/direwolf/Config.in"
source "$BR2_EXTERNAL_APRSPI_PATH/package/svox/Config.in"
```

## configs/aprspi_raspberrypi3_defconfig
```kconfig
BR2_arm=y
BR2_cortex_a53=y
BR2_ARM_FPU_NEON_VFPV4=y
BR2_CCACHE=y
BR2_OPTIMIZE_FAST=y
BR2_GLOBAL_PATCH_DIR="$(BR2_EXTERNAL_APRSPI_PATH)/patches/"
BR2_TOOLCHAIN_BUILDROOT_GLIBC=y
BR2_BINUTILS_VERSION_2_31_X=y
BR2_GCC_VERSION_8_X=y
BR2_TOOLCHAIN_BUILDROOT_CXX=y
BR2_TARGET_GENERIC_HOSTNAME="aprspi"
BR2_TARGET_GENERIC_ISSUE="APRS TNC & Tracker on Raspberry Pi"
BR2_INIT_SYSTEMD=y
BR2_TARGET_GENERIC_ROOT_PASSWD="aprspi"
BR2_TARGET_GENERIC_GETTY_PORT="tty1"
BR2_ROOTFS_USERS_TABLES="$(BR2_EXTERNAL_APRSPI_PATH)/board/common/users"
BR2_ROOTFS_OVERLAY="$(BR2_EXTERNAL_APRSPI_PATH)/board/common/rootfs-overlay"
BR2_ROOTFS_POST_BUILD_SCRIPT="board/raspberrypi3/post-build.sh"
BR2_ROOTFS_POST_IMAGE_SCRIPT="$(BR2_EXTERNAL_APRSPI_PATH)/board/raspberrypi3/post-image.sh"
BR2_ROOTFS_POST_SCRIPT_ARGS="--aarch64"
BR2_LINUX_KERNEL=y
BR2_LINUX_KERNEL_CUSTOM_TARBALL=y
BR2_LINUX_KERNEL_CUSTOM_TARBALL_LOCATION="$(call github,raspberrypi,linux,014826d14af16b73969af8cf34f1ce7ecfb58702)/linux-014826d14af16b73969af8cf34f1ce7ecfb58702.tar.gz"
BR2_LINUX_KERNEL_DEFCONFIG="bcm2709"
BR2_LINUX_KERNEL_CONFIG_FRAGMENT_FILES="$(BR2_EXTERNAL_APRSPI_PATH)/board/raspberrypi3/kernel-raspberrypi3.config"
BR2_LINUX_KERNEL_DTS_SUPPORT=y
BR2_LINUX_KERNEL_INTREE_DTS_NAME="bcm2710-rpi-3-b bcm2710-rpi-3-b-plus bcm2710-rpi-cm3"
BR2_LINUX_KERNEL_NEEDS_HOST_OPENSSL=y
BR2_PACKAGE_LINUX_TOOLS_GPIO=y
BR2_PACKAGE_BUSYBOX_CONFIG_FRAGMENT_FILES="$(BR2_EXTERNAL_APRSPI_PATH)/board/common/busybox.config"
BR2_PACKAGE_ALSA_UTILS=y
# BR2_PACKAGE_ALSA_UTILS_ALSACTL is not set
BR2_PACKAGE_ALSA_UTILS_APLAY=y
BR2_PACKAGE_PULSEAUDIO=y
BR2_PACKAGE_PULSEAUDIO_DAEMON=y
BR2_PACKAGE_RPI_BT_FIRMWARE=y
BR2_PACKAGE_RPI_FIRMWARE=y
BR2_PACKAGE_RPI_WIFI_FIRMWARE=y
BR2_PACKAGE_GPSD_DEVICES=""
BR2_PACKAGE_GPSD_PPS=y
# BR2_PACKAGE_GPSD_CONTROLSEND is not set
BR2_PACKAGE_GPSD_ASHTECH=y
BR2_PACKAGE_GPSD_EARTHMATE=y
BR2_PACKAGE_GPSD_EVERMORE=y
BR2_PACKAGE_GPSD_FURY=y
BR2_PACKAGE_GPSD_FV18=y
BR2_PACKAGE_GPSD_GARMIN=y
BR2_PACKAGE_GPSD_GARMIN_SIMPLE_TXT=y
BR2_PACKAGE_GPSD_GEOSTAR=y
BR2_PACKAGE_GPSD_GPSCLOCK=y
BR2_PACKAGE_GPSD_GREIS=y
BR2_PACKAGE_GPSD_ISYNC=y
BR2_PACKAGE_GPSD_ITRAX=y
BR2_PACKAGE_GPSD_MTK3301=y
BR2_PACKAGE_GPSD_NMEA2000=y
BR2_PACKAGE_GPSD_NTRIP=y
BR2_PACKAGE_GPSD_OCEANSERVER=y
BR2_PACKAGE_GPSD_ONCORE=y
BR2_PACKAGE_GPSD_RTCM104V2=y
BR2_PACKAGE_GPSD_RTCM104V3=y
BR2_PACKAGE_GPSD_SIRF=y
BR2_PACKAGE_GPSD_SUPERSTAR2=y
BR2_PACKAGE_GPSD_TRIMBLE_TSIP=y
BR2_PACKAGE_GPSD_TRIPMATE=y
BR2_PACKAGE_GPSD_TRUE_NORTH=y
BR2_PACKAGE_GPSD_UBX=y
BR2_PACKAGE_RNG_TOOLS=y
BR2_PACKAGE_LINUX_PAM=y
BR2_PACKAGE_BLUEZ5_UTILS=y
BR2_PACKAGE_BLUEZ5_UTILS_CLIENT=y
BR2_PACKAGE_BLUEZ5_UTILS_DEPRECATED=y
BR2_PACKAGE_CHRONY=y
BR2_PACKAGE_IWD=y
BR2_PACKAGE_OPENSSH=y
BR2_PACKAGE_SOCAT=y
BR2_PACKAGE_WIRELESS_REGDB=y
BR2_PACKAGE_HTOP=y
BR2_PACKAGE_SYSTEMD_JOURNAL_GATEWAY=y
# BR2_PACKAGE_SYSTEMD_HWDB is not set
BR2_PACKAGE_SYSTEMD_LOGIND=y
# BR2_PACKAGE_SYSTEMD_MYHOSTNAME is not set
BR2_PACKAGE_SYSTEMD_POLKIT=y
BR2_PACKAGE_SYSTEMD_SYSUSERS=y
# BR2_PACKAGE_SYSTEMD_TIMESYNCD is not set
# BR2_PACKAGE_SYSTEMD_VCONSOLE is not set
BR2_TARGET_ROOTFS_CPIO_LZ4=y
BR2_TARGET_ROOTFS_INITRAMFS=y
# BR2_TARGET_ROOTFS_TAR is not set
BR2_PACKAGE_HOST_DOSFSTOOLS=y
BR2_PACKAGE_HOST_GENIMAGE=y
BR2_PACKAGE_HOST_MTOOLS=y
BR2_PACKAGE_HOST_UTIL_LINUX=y
BR2_PACKAGE_DIREWOLF=y
BR2_PACKAGE_SVOX=y
BR2_PACKAGE_ALSA_PLUGINS=y
```

## configs/aprspi_raspi3_defconfig
```kconfig
BR2_aarch64=y
BR2_ARM_FPU_VFPV4=y
BR2_CCACHE=y
BR2_OPTIMIZE_FAST=y
BR2_GLOBAL_PATCH_DIR="$(BR2_EXTERNAL_APRSPI_PATH)/patches/"
BR2_TOOLCHAIN_BUILDROOT_GLIBC=y
BR2_BINUTILS_VERSION_2_31_X=y
BR2_GCC_VERSION_8_X=y
BR2_TOOLCHAIN_BUILDROOT_CXX=y
BR2_TARGET_GENERIC_HOSTNAME="aprspi"
BR2_TARGET_GENERIC_ISSUE="APRS TNC & Tracker on Raspberry Pi"
BR2_TARGET_GENERIC_PASSWD_SHA256=y
BR2_INIT_SYSTEMD=y
BR2_TARGET_GENERIC_ROOT_PASSWD="tester"
BR2_TARGET_GENERIC_GETTY_PORT="tty1"
# BR2_TARGET_GENERIC_REMOUNT_ROOTFS_RW is not set
BR2_ROOTFS_OVERLAY="$(BR2_EXTERNAL_APRSPI_PATH)/board/common/rootfs-overlay"
BR2_ROOTFS_POST_BUILD_SCRIPT="board/raspberrypi3-64/post-build.sh $(BR2_EXTERNAL_APRSPI_PATH)/board/common/post-build.sh"
BR2_ROOTFS_POST_IMAGE_SCRIPT="$(BR2_EXTERNAL_APRSPI_PATH)/board/raspberrypi3-64/post-image.sh"
BR2_ROOTFS_POST_SCRIPT_ARGS="--aarch64"
BR2_LINUX_KERNEL=y
BR2_LINUX_KERNEL_CUSTOM_TARBALL=y
BR2_LINUX_KERNEL_CUSTOM_TARBALL_LOCATION="$(call github,raspberrypi,linux,8856a02fde6ff0bc367d23cf0c33d5b663b5d5a1)/linux-8856a02fde6ff0bc367d23cf0c33d5b663b5d5a1.tar.gz"
BR2_LINUX_KERNEL_DEFCONFIG="bcmrpi3"
BR2_LINUX_KERNEL_CONFIG_FRAGMENT_FILES="$(BR2_EXTERNAL_APRSPI_PATH)/board/raspberrypi3-64/kernel.config"
BR2_LINUX_KERNEL_DTS_SUPPORT=y
BR2_LINUX_KERNEL_INTREE_DTS_NAME="broadcom/bcm2710-rpi-3-b broadcom/bcm2710-rpi-3-b-plus broadcom/bcm2837-rpi-3-b"
BR2_LINUX_KERNEL_NEEDS_HOST_OPENSSL=y
BR2_PACKAGE_ALSA_UTILS=y
BR2_PACKAGE_ALSA_UTILS_AMIXER=y
BR2_PACKAGE_ALSA_UTILS_APLAY=y
BR2_PACKAGE_RPI_BT_FIRMWARE=y
BR2_PACKAGE_RPI_FIRMWARE=y
BR2_PACKAGE_RPI_WIFI_FIRMWARE=y
BR2_PACKAGE_GPSD_DEVICES=""
BR2_PACKAGE_GPSD_PPS=y
# BR2_PACKAGE_GPSD_CONTROLSEND is not set
BR2_PACKAGE_GPSD_ASHTECH=y
BR2_PACKAGE_GPSD_EARTHMATE=y
BR2_PACKAGE_GPSD_EVERMORE=y
BR2_PACKAGE_GPSD_FURY=y
BR2_PACKAGE_GPSD_FV18=y
BR2_PACKAGE_GPSD_GARMIN=y
BR2_PACKAGE_GPSD_GARMIN_SIMPLE_TXT=y
BR2_PACKAGE_GPSD_GEOSTAR=y
BR2_PACKAGE_GPSD_GPSCLOCK=y
BR2_PACKAGE_GPSD_GREIS=y
BR2_PACKAGE_GPSD_ISYNC=y
BR2_PACKAGE_GPSD_ITRAX=y
BR2_PACKAGE_GPSD_MTK3301=y
BR2_PACKAGE_GPSD_NMEA2000=y
BR2_PACKAGE_GPSD_NTRIP=y
BR2_PACKAGE_GPSD_OCEANSERVER=y
BR2_PACKAGE_GPSD_ONCORE=y
BR2_PACKAGE_GPSD_RTCM104V2=y
BR2_PACKAGE_GPSD_RTCM104V3=y
BR2_PACKAGE_GPSD_SIRF=y
BR2_PACKAGE_GPSD_SUPERSTAR2=y
BR2_PACKAGE_GPSD_TRIMBLE_TSIP=y
BR2_PACKAGE_GPSD_TRIPMATE=y
BR2_PACKAGE_GPSD_TRUE_NORTH=y
BR2_PACKAGE_GPSD_UBX=y
BR2_PACKAGE_PICOCOM=y
BR2_PACKAGE_RNG_TOOLS=y
BR2_PACKAGE_BLUEZ5_UTILS=y
BR2_PACKAGE_BLUEZ5_UTILS_CLIENT=y
BR2_PACKAGE_CHRONY=y
BR2_PACKAGE_OPENSSH=y
BR2_PACKAGE_WIRELESS_REGDB=y
BR2_PACKAGE_HTOP=y
# BR2_PACKAGE_SYSTEMD_HOSTNAMED is not set
# BR2_PACKAGE_SYSTEMD_HWDB is not set
# BR2_PACKAGE_SYSTEMD_MYHOSTNAME is not set
# BR2_PACKAGE_SYSTEMD_TIMEDATED is not set
# BR2_PACKAGE_SYSTEMD_TIMESYNCD is not set
BR2_TARGET_ROOTFS_CPIO_LZ4=y
BR2_TARGET_ROOTFS_INITRAMFS=y
# BR2_TARGET_ROOTFS_TAR is not set
BR2_PACKAGE_HOST_DOSFSTOOLS=y
BR2_PACKAGE_HOST_GENIMAGE=y
BR2_PACKAGE_HOST_MTOOLS=y
BR2_PACKAGE_HOST_UTIL_LINUX=y
BR2_PACKAGE_IWD=y
BR2_PACKAGE_DIREWOLF=y
```

## package/alsa-plugins/Config.in
```kconfig
config BR2_PACKAGE_ALSA_PLUGINS
	bool "alsa-plugins"
	select BR2_PACKAGE_PULSEAUDIO
	depends on BR2_PACKAGE_ALSA_LIB
	help
	  Advanced Linux Sound Architecture Plugins

	  http://www.alsa-project.org/
```

## package/direwolf/Config.in
```kconfig
config BR2_PACKAGE_DIREWOLF
        bool "direwolf"
        select BR2_PACKAGE_ALSA_LIB
        select BR2_PACKAGE_GPSD
        select BR2_PACKAGE_HAMLIB
        select BR2_PACKAGE_HOST_GEN_FFF
	depends on BR2_PACKAGE_HAS_UDEV
        help
          Dire Wolf is a software "soundcard" AX.25 packet modem/TNC
          and APRS encoder/decoder.

          https://github.com/wb2osz/direwolf/
```

## package/dsd/Config.in
```kconfig
config BR2_PACKAGE_DSD
        bool "dsd"
        select BR2_PACKAGE_MBELIB
	select BR2_PACKAGE_LIBSNDFILE
	select BR2_PACKAGE_ITPP
	select BR2_PACKAGE_PORTAUDIO
        help
          Digital Speech Decoder

          https://github.com/szechyjs/dsd
```

## package/ell/Config.in
```kconfig
config BR2_PACKAGE_ELL
        bool "ell"
	depends on BR2_TOOLCHAIN_USES_GLIBC
        help
          The Embedded Linux* Library (ELL) provides core, low-level
          functionality for system daemons.

          https://git.kernel.org/pub/scm/libs/ell/ell.git/

          ell needs a glibc toolchain
```

## package/gen_fff/Config.in.host
```kconfig
config BR2_PACKAGE_HOST_GEN_FFF
        bool "host gen_fff"
        help
          gen_fff generates fsk_fast_filter.h needed to compile
          Direwolf.

          https://github.com/wb2osz/direwolf/
```

## package/hamlib/Config.in
```kconfig
config BR2_PACKAGE_HAMLIB
        bool "hamlib"
        select BR2_PACKAGE_READLINE
	select BR2_PACKAGE_LIBUSB
        help
          Ham radio control library

          https://hamlib.github.io/
```

## package/itpp/Config.in
```kconfig
config BR2_PACKAGE_ITPP
        bool "itpp"
	select BR2_PACKAGE_LAPACK
	select BR2_PACKAGE_FFTW
	select BR2_PACKAGE_FFTW_DOUBLE
        help
          IT++ is a C++ library of mathematical, signal processing
	  and communication classes and functions.

          https://sourceforge.net/projects/itpp/
```

## package/iwd/Config.in
```kconfig
config BR2_PACKAGE_IWD
        bool "iwd"
        select BR2_PACKAGE_READLINE
        select BR2_PACKAGE_ELL
	depends on BR2_TOOLCHAIN_USES_GLIBC
        help
          Minimalistic wireless daemon that uses modern Linux interfaces
          like cfg80211 and nl80211 (netlink).

          https://git.kernel.org/pub/scm/network/wireless/iwd.git/

          iwd needs a glibc toolchain
```

## package/mbelib/Config.in
```kconfig
config BR2_PACKAGE_MBELIB
        bool "mbelib"
        help
          P25 Phase 1 and ProVoice vocoder

          https://github.com/szechyjs/mbelib
```

## package/minimodem/Config.in
```kconfig
config BR2_PACKAGE_MINIMODEM
	bool "minimodem"
	select BR2_PACKAGE_ALSA_LIB
	select BR2_PACKAGE_PULSEAUDIO
	select BR2_PACKAGE_LIBSNDFILE
	select BR2_PACKAGE_FFTW_SINGLE
	help
	  general-purpose software audio FSK modem

	  http://www.whence.com/minimodem/
```

## package/multimon-ng/Config.in
```kconfig
config BR2_PACKAGE_MULTIMON_NG
        bool "multimon-ng"
        select BR2_PACKAGE_PULSEAUDIO
        help
          program to decode radio transmissions

          https://github.com/EliasOenal/multimon-ng
```

## package/ncpamixer/Config.in
```kconfig
config BR2_PACKAGE_NCPAMIXER
	bool "ncpamixer"
	depends on BR2_PACKAGE_NCURSES
	help
	  ncurses PulseAudio Mixer

	  https://github.com/fulhax/ncpamixer
```

## package/svox/Config.in
```kconfig
config BR2_PACKAGE_SVOX
	bool "svox"
        select BR2_PACKAGE_POPT
	help
          The SVOX Pico engine is a software speech synthesizer for German,
          English (GB and US), Spanish, French and Italian.

          SVOX produces a clear and distinct speech output made possible by
          the use of Hidden Markov Model (HMM) algorithms. 
```
